## meta-ebaz4205/conf/machine/ebaz4205-zynq7.conf
```bitbake
#@TYPE: Machine
#@NAME: ebaz4205-zynq7
#@DESCRIPTION: Machine support for EBAZ4205.

# Inherit from picozed
require conf/machine/picozed-zynq7.conf

# Custom device tree
KERNEL_DEVICETREE = "zynq-ebaz4205.dtb"

SERIAL_CONSOLES ?= "115200;ttyPS0"
```
